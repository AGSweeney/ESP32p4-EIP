## main/Kconfig.projbuild
```kconfig
menu "OpenER Ethernet Configuration"
    config OPENER_ETH_PHY_ADDR
        int "Ethernet PHY address"
        range 0 31
        default 1
    config OPENER_ETH_PHY_RST_GPIO
        int "Ethernet PHY reset GPIO"
        default 51
    config OPENER_ETH_MDC_GPIO
        int "Ethernet MDC GPIO"
        default 31
    config OPENER_ETH_MDIO_GPIO
        int "Ethernet MDIO GPIO"
        default 52
endmenu

menu "OpenER I2C Configuration"
    config OPENER_I2C_SCL_GPIO
        int "I2C SCL GPIO"
        default 8
        help
            GPIO pin number for I2C clock line (SCL)
    
    config OPENER_I2C_SDA_GPIO
        int "I2C SDA GPIO"
        default 7
        help
            GPIO pin number for I2C data line (SDA)
endmenu

menu "OpenER ACD Timing"
    config OPENER_ACD_CUSTOM_TIMING
        bool "Override default RFC5227 timings"
        default y
        help
            Enable this option to tune IPv4 Address Conflict Detection timings to match
            EtherNet/IP requirements. When disabled, lwIP falls back to RFC5227 defaults.

    if OPENER_ACD_CUSTOM_TIMING
        config OPENER_ACD_PROBE_WAIT_MS
            int "Initial probe wait (ms)"
            default 200
            help
                Maximum initial delay before the first probe is sent. Set to 0 for no delay.

        config OPENER_ACD_PROBE_MIN_MS
            int "Minimum delay between probes (ms)"
            default 200

        config OPENER_ACD_PROBE_MAX_MS
            int "Maximum delay between probes (ms)"
            default 200

        config OPENER_ACD_PROBE_NUM
            int "Number of probes"
            default 3

        config OPENER_ACD_ANNOUNCE_NUM
            int "Number of announcements"
            default 4

        config OPENER_ACD_ANNOUNCE_INTERVAL_MS
            int "Interval between announcements (ms)"
            default 2000

        config OPENER_ACD_ANNOUNCE_WAIT_MS
            int "Delay before first announcement (ms)"
            default 2000
    endif
endmenu
```

## sdkconfig.defaults
```kconfig
CONFIG_LWIP_DHCP_DOES_ACD_CHECK=y
# CONFIG_LWIP_DHCP_DOES_ARP_CHECK is not set
CONFIG_LWIP_AUTOIP=y
CONFIG_LWIP_DEBUG=y
CONFIG_OPENER_ACD_CUSTOM_TIMING=y
CONFIG_OPENER_ACD_PROBE_WAIT_MS=0
CONFIG_OPENER_ACD_PROBE_MIN_MS=20
CONFIG_OPENER_ACD_PROBE_MAX_MS=20
CONFIG_OPENER_ACD_PROBE_NUM=1
CONFIG_OPENER_ACD_ANNOUNCE_NUM=1
CONFIG_OPENER_ACD_ANNOUNCE_INTERVAL_MS=20
CONFIG_OPENER_ACD_ANNOUNCE_WAIT_MS=20
```
